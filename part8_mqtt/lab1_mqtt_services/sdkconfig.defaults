## part8_mqtt/lab1_mqtt_services/sdkconfig.defaults
```kconfig
CONFIG_ESPTOOLPY_FLASHSIZE_4MB=y
CONFIG_ESPTOOLPY_FLASHSIZE="4MB"

# Connection to WiFi Box
CONFIG_WIFI_SSID="raspi-box-esp32"
CONFIG_WIFI_PASSWORD="PolytechBoxRasp"

# ESP-TLS
CONFIG_ESP_TLS_USING_MBEDTLS=y
CONFIG_ESP_TLS_INSECURE=y
CONFIG_ESP_TLS_SKIP_SERVER_CERT_VERIFY=y
```
